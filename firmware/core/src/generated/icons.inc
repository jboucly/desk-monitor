// Generated by firmware/tools/gen_assets.mjs from protocol/icons.json. Do not edit.
{"home", "\xF3\xB0\x8B\x9C"},
{"home-assistant", "\xF3\xB0\x9F\x90"},
{"home-lightning-bolt", "\xF3\xB1\xA4\x83"},
{"sofa", "\xF3\xB0\x92\xB9"},
{"bed", "\xF3\xB0\x8B\xA3"},
{"desk", "\xF3\xB1\x88\xB9"},
{"door", "\xF3\xB0\xA0\x9A"},
{"garage", "\xF3\xB0\x9B\x99"},
{"blinds", "\xF3\xB0\x82\xAC"},
{"curtains", "\xF3\xB1\xA1\x86"},
{"lightbulb", "\xF3\xB0\x8C\xB5"},
{"lightbulb-outline", "\xF3\xB0\x8C\xB6"},
{"lightbulb-group", "\xF3\xB1\x89\x93"},
{"ceiling-light", "\xF3\xB0\x9D\xA9"},
{"floor-lamp", "\xF3\xB0\xA3\x9D"},
{"desk-lamp", "\xF3\xB0\xA5\x9F"},
{"lamp", "\xF3\xB0\x9A\xB5"},
{"led-strip-variant", "\xF3\xB1\x81\x91"},
{"string-lights", "\xF3\xB1\x8A\xBA"},
{"power", "\xF3\xB0\x90\xA5"},
{"power-plug", "\xF3\xB0\x9A\xA5"},
{"power-socket-eu", "\xF3\xB0\x9F\xA7"},
{"toggle-switch", "\xF3\xB0\x94\xA1"},
{"fan", "\xF3\xB0\x88\x90"},
{"air-conditioner", "\xF3\xB0\x80\x9B"},
{"radiator", "\xF3\xB0\x90\xB8"},
{"thermometer", "\xF3\xB0\x94\x8F"},
{"water-percent", "\xF3\xB0\x96\x8E"},
{"robot-vacuum", "\xF3\xB0\x9C\x8D"},
{"television", "\xF3\xB0\x94\x82"},
{"speaker", "\xF3\xB0\x93\x83"},
{"lock", "\xF3\xB0\x8C\xBE"},
{"lock-open-variant", "\xF3\xB0\xBF\x86"},
{"bell", "\xF3\xB0\x82\x9A"},
{"camera", "\xF3\xB0\x84\x80"},
{"palette", "\xF3\xB0\x8F\x98"},
{"brightness-6", "\xF3\xB0\x83\x9F"},
{"white-balance-sunny", "\xF3\xB0\x96\xA8"},
{"coffee", "\xF3\xB0\x85\xB6"},
{"sleep", "\xF3\xB0\x92\xB2"},
{"movie", "\xF3\xB0\x8E\x81"},
{"gamepad-variant", "\xF3\xB0\x8A\x97"},
{"gauge", "\xF3\xB0\x8A\x9A"},
{"server", "\xF3\xB0\x92\x8B"},
{"server-network", "\xF3\xB0\x92\x8D"},
{"cpu-64-bit", "\xF3\xB0\xBB\xA0"},
{"memory", "\xF3\xB0\x8D\x9B"},
{"harddisk", "\xF3\xB0\x8B\x8A"},
{"expansion-card", "\xF3\xB0\xA2\xAE"},
{"chip", "\xF3\xB0\x98\x9A"},
{"lan", "\xF3\xB0\x8C\x97"},
{"fire", "\xF3\xB0\x88\xB8"},
{"wifi", "\xF3\xB0\x96\xA9"},
{"wifi-off", "\xF3\xB0\x96\xAA"},
{"wifi-strength-1", "\xF3\xB0\xA4\x9F"},
{"wifi-strength-2", "\xF3\xB0\xA4\xA2"},
{"wifi-strength-3", "\xF3\xB0\xA4\xA5"},
{"wifi-strength-4", "\xF3\xB0\xA4\xA8"},
{"bluetooth", "\xF3\xB0\x82\xAF"},
{"bluetooth-off", "\xF3\xB0\x82\xB2"},
{"bluetooth-connect", "\xF3\xB0\x82\xB1"},
{"monitor", "\xF3\xB0\x8D\xB9"},
{"laptop", "\xF3\xB0\x8C\xA2"},
{"desktop-tower", "\xF3\xB0\x87\x85"},
{"keyboard", "\xF3\xB0\x8C\x8C"},
{"console", "\xF3\xB0\x86\x8D"},
{"music", "\xF3\xB0\x9D\x9A"},
{"play", "\xF3\xB0\x90\x8A"},
{"pause", "\xF3\xB0\x8F\xA4"},
{"play-pause", "\xF3\xB0\x90\x8E"},
{"skip-next", "\xF3\xB0\x92\xAD"},
{"skip-previous", "\xF3\xB0\x92\xAE"},
{"volume-high", "\xF3\xB0\x95\xBE"},
{"volume-off", "\xF3\xB0\x96\x81"},
{"microphone", "\xF3\xB0\x8D\xAC"},
{"microphone-off", "\xF3\xB0\x8D\xAD"},
{"video", "\xF3\xB0\x95\xA7"},
{"video-off", "\xF3\xB0\x95\xA8"},
{"spotify", "\xF3\xB0\x93\x87"},
{"apple", "\xF3\xB0\x80\xB5"},
{"microsoft-windows", "\xF3\xB0\x96\xB3"},
{"web", "\xF3\xB0\x96\x9F"},
{"google-chrome", "\xF3\xB0\x8A\xAF"},
{"firefox", "\xF3\xB0\x88\xB9"},
{"folder", "\xF3\xB0\x89\x8B"},
{"email", "\xF3\xB0\x87\xAE"},
{"calendar", "\xF3\xB0\x83\xAD"},
{"github", "\xF3\xB0\x8A\xA4"},
{"slack", "\xF3\xB0\x92\xB1"},
{"microsoft-visual-studio-code", "\xF3\xB0\xA8\x9E"},
{"application", "\xF3\xB0\xA3\x86"},
{"open-in-new", "\xF3\xB0\x8F\x8C"},
{"link", "\xF3\xB0\x8C\xB7"},
{"rocket-launch", "\xF3\xB1\x93\x9E"},
{"star", "\xF3\xB0\x93\x8E"},
{"heart", "\xF3\xB0\x8B\x91"},
{"clock-outline", "\xF3\xB0\x85\x90"},
{"timer-outline", "\xF3\xB0\x94\x9B"},
{"cog", "\xF3\xB0\x92\x93"},
{"plus", "\xF3\xB0\x90\x95"},
{"close", "\xF3\xB0\x85\x96"},
{"check", "\xF3\xB0\x84\xAC"},
{"chevron-left", "\xF3\xB0\x85\x81"},
{"chevron-right", "\xF3\xB0\x85\x82"},
{"chevron-up", "\xF3\xB0\x85\x83"},
{"chevron-down", "\xF3\xB0\x85\x80"},
{"alert-circle-outline", "\xF3\xB0\x97\x96"},
{"weather-sunny", "\xF3\xB0\x96\x99"},
{"weather-night", "\xF3\xB0\x96\x94"},
{"weather-partly-cloudy", "\xF3\xB0\x96\x95"},
{"weather-night-partly-cloudy", "\xF3\xB0\xBC\xB1"},
{"weather-cloudy", "\xF3\xB0\x96\x90"},
{"weather-fog", "\xF3\xB0\x96\x91"},
{"weather-rainy", "\xF3\xB0\x96\x97"},
{"weather-pouring", "\xF3\xB0\x96\x96"},
{"weather-snowy", "\xF3\xB0\x96\x98"},
{"weather-snowy-rainy", "\xF3\xB0\x99\xBF"},
{"weather-snowy-heavy", "\xF3\xB0\xBC\xB6"},
{"weather-lightning", "\xF3\xB0\x96\x93"},
{"weather-lightning-rainy", "\xF3\xB0\x99\xBE"},
{"weather-hail", "\xF3\xB0\x96\x92"},
{"weather-windy", "\xF3\xB0\x96\x9D"},
{"weather-sunset-up", "\xF3\xB0\x96\x9C"},
{"weather-sunset-down", "\xF3\xB0\x96\x9B"},
{"water", "\xF3\xB0\x96\x8C"},
{"umbrella-outline", "\xF3\xB0\x95\x8B"},
{"download", "\xF3\xB0\x87\x9A"},
{"upload", "\xF3\xB0\x95\x92"},
{"lan-disconnect", "\xF3\xB0\x8C\x99"},
